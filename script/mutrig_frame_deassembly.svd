# MU3E_MUTRIG_FRAME_DEASSEMBLY register map
Vendor: Mu3e; Series: MU3E_FPGA_IP; File version: 26.1.0.0506
CMSIS-SVD description of the mutrig_frame_deassembly CSR window. This first-pass schema exposes the 4-word relative aperture as read-only WORD registers until the IP author publishes field-accurate semantics.
Registers are 32-bit, read-only, reset 0x0 unless marked. A register's access mark holds for its fields unless they carry their own. Offsets are from the block's base; lines under a group give offsets from that group; [hi:lo] are bit positions; {n}, {i} and the like mark numbered series; 'fields as' and 'values as' point back to an identical list; <NAME> marks a mode.

## Memory map
0x00000000 MUTRIG_FRAME_DEASSEMBLY_CSR size 0x10 — Relative 4-word CSR aperture for MuTRiG frame deassembly.

## MUTRIG_FRAME_DEASSEMBLY_CSR — Relative 4-word CSR aperture for MuTRiG frame deassembly.
Base 0x00000000
{0x0+4i} WORD{i:03} (i=0..3) — MuTRiG frame deassembly CSR word {i}.
  [31:0] value — Raw MuTRiG frame deassembly CSR word {i}.
